## config/west.yml
```yaml
manifest:
  remotes:
    - name: zmkfirmware
      url-base: https://github.com/zmkfirmware
    - name: unspecworks  
      url-base: https://github.com/unspecworks   
  projects:
    - name: zmk
      remote: zmkfirmware
      revision: main
      import: app/west.yml
    - name: visorbearer-zmk-module   
      remote: unspecworks  
      revision: main 
  self:
    path: config
```
